## boards/ami_lab/earworm/Kconfig.defconfig
```kconfig
if BOARD_EARWORM_CPUAPP

config BT_CTLR
	default BT

config ROM_START_OFFSET
	default 0x800 if BOOTLOADER_MCUBOOT

config GPIO
    default y

endif # BOARD_EARWORM_CPUAPP
```

## boards/ami_lab/earworm/Kconfig.earworm
```kconfig
config BOARD_EARWORM
	select SOC_NRF54L15_CPUAPP if BOARD_EARWORM_NRF54L15_CPUAPP
	select SOC_NRF54L15_CPUFLPR if \
		BOARD_EARWORM_NRF54L15_CPUFLPR || \
		BOARD_EARWORM_NRF54L15_CPUFLPR_XIP
```

## boards/ami_lab/earworm/board.yml
```yaml
board:
  name: earworm
  vendor: ami_lab
  socs:
  - name: nrf54l15
    variants:
    - name: ns
      cpucluster: cpuapp
    - name: xip
      cpucluster: cpuflpr
```

## boards/ami_lab/earworm/earworm_nrf54l15_cpuapp_defconfig
```kconfig
CONFIG_ARM_MPU=y
CONFIG_HW_STACK_PROTECTION=y

CONFIG_NULL_POINTER_EXCEPTION_DETECTION_NONE=y

CONFIG_CACHE_MANAGEMENT=y
CONFIG_EXTERNAL_CACHE=y

CONFIG_NRF_GRTC_START_SYSCOUNTER=y

# Enable RTT
CONFIG_USE_SEGGER_RTT=y

# enable GPIO
CONFIG_GPIO=y

# enable UART driver
CONFIG_SERIAL=y

# enable console
CONFIG_CONSOLE=y
CONFIG_UART_CONSOLE=y

# enable external LFCLK
CONFIG_CLOCK_CONTROL=y
CONFIG_CLOCK_CONTROL_NRF=y
CONFIG_CLOCK_CONTROL_NRF_K32SRC_XTAL=y  
CONFIG_CLOCK_CONTROL_NRF_K32SRC_20PPM=y

CONFIG_PINCTRL=y
CONFIG_BUILD_WITH_TFM=y
CONFIG_PARTITION_MANAGER_ENABLED=y
CONFIG_PM=y
CONFIG_MQTT_LIB_TLS=y
```
